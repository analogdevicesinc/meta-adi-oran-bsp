## conf/layer.conf
```bitbake
# We have a conf and classes directory, append to BBPATH
BBPATH:append = ":${LAYERDIR}"

# We have a recipes directory, add to BBFILES
BBFILES:append = " ${LAYERDIR}/recipes*/*/*.bb \
                   ${LAYERDIR}/recipes*/*/*.bbappend \
                   ${LAYERDIR}/recipes*/*/*/*.bb \
                   ${LAYERDIR}/recipes*/*/*/*.bbappend "

# these recipes are only included if the meta-intel-fpga layer is in use.
BBFILES_DYNAMIC:append = " meta-intel-fpga:${LAYERDIR}/intel-fpga/recipes*/*/*.bb \
                           meta-intel-fpga:${LAYERDIR}/intel-fpga/recipes*/*/*.bbappend \
                           meta-intel-fpga:${LAYERDIR}/intel-fpga/recipes*/*/*/*.bb \
                           meta-intel-fpga:${LAYERDIR}/intel-fpga/recipes*/*/*/*.bbappend "

BBFILE_COLLECTIONS:append = " meta-adi-oran-bsp"
BBFILE_PATTERN_meta-adi-oran-bsp := "^${LAYERDIR}/"

# Set the layer priority
BBFILE_PRIORITY:meta-adi-oran-bsp = "6"
# Layer dependencies
LAYERDEPENDS:meta-adi-oran-bsp:append =  " core"

# Dependencies for platforms
LAYERDEPENDS:meta-adi-oran-bsp =  "${@bb.utils.contains('ADI_CC_INTEL_FPGA','1','meta-intel-fpga meta-python','', d)}"

# Version decsription:              stable
LAYERSERIES_COMPAT_meta-adi-oran-bsp = "kirkstone"

# Additional license directories
#LICENSE_PATH:append = " ${LAYERDIR}/files/custom-licenses"

BBDEBUG = "yes"
```

## conf/machine/adrv904x-rd-ru.conf
```bitbake
#@TYPE: Machine
#@NAME: ADRV904X-RD-RU
#@DESCRIPTION: Machine configuration for the ADI ADRV904X-RD-RU SoCFPGA

require include/adi_socfpga_default_settings.inc

UBOOT_CONFIG ??= "${MACHINE}"

KERNEL_DEVICETREE ??= "adi/socfpga_${MACHINE}_socdk.dtb"

# the actual hardware uses ttyS0 -- but QEMU uses ttyAMA0
# (sysvinit takes care of detecting which one is present)
SERIAL_CONSOLES ?= "115200;ttyS0 115200;ttyAMA0"
SERIAL_CONSOLES_CHECK = "${SERIAL_CONSOLES}"
APPEND:append = " uio_pdrv_genirq.of_id=generic-uio earlyprintk"

QUARTUS_VER ?= "21.3"
QUARTUS_PROJ_NAME ?= "agilex"
SOC_FPGA_PARTNUM ?= "AGFB014R24B"

IMAGE_BOOT_FILES ?= " \
            ${UBOOT_IMAGE_FILE} \
            ${KERNEL_IMAGE_FILE} \
            u-boot.scr \
            socfpga_${MACHINE}_socdk.dtb \
            ${SOC_FPGA_PARTNUM}.core.rbf \
            ${SOC_FPGA_PARTNUM}_hps.jic \
            "

BOOT_SIZE ?= "1000M"
ROOTFS_SIZE ?= "3000M"
WKS_FILE ?= "sdimage-adi.wks.in"
IMAGE_FSTYPES += "wic wic.gz"
hostname_pn-base-files ??= "${MACHINE}"

SOC_FPGA = "agilex"

#Select INTEL-FPGA or not
ADI_CC_INTEL_FPGA ?= "1"

# Select boot files based on whether Trusted Firmware and/or RSU is enabled
ADI_CC_TFA ?= "1"
ADI_CC_RSU ?= "0"
UBOOT_IMAGE_FILE ?= "${@bb.utils.contains('ADI_CC_TFA', '1', 'u-boot.itb', '${UBOOT_BINARY}', d)}"

KERNEL_IMAGE_FILE ?= "${@bb.utils.contains('ADI_CC_TFA', '1', 'kernel.itb', '${KERNEL_IMAGETYPE}', d)}"

IMAGE_BOOT_FILES:append ?= "${@bb.utils.contains('ADI_CC_RSU','1',' \
            rsu/${SOC_FPGA_PARTNUM}.rpd \
            rsu/initial_image_${MACHINE}.jic \
            rsu/factory_image.rpd \
            rsu/decision_firmware_update.rpd \
            ', ' ', d)}"

IMAGE_BOOT_FILES:remove ?= "${@bb.utils.contains('ADI_CC_TFA', '1', 'socfpga_${MACHINE}_socdk.dtb', '', d)}"
IMAGE_BOOT_FILES:remove ?= "${@bb.utils.contains('ADI_CC_RSU', '1', '${SOC_FPGA_PARTNUM}_hps.jic', '', d)}"

require include/qemu_defaults.inc
```

## conf/machine/include/adi_default_providers.inc
```bitbake
PREFERRED_PROVIDER_linux                    ?= "linux-adi"
PREFERRED_PROVIDER_virtual/kernel           ?= "linux-adi"
PREFERRED_PROVIDER_trusted-firmware-a       ?= "trusted-firmware-a-adi"
PREFERRED_PROVIDER_u-boot                   ?= "u-boot-adi"
PREFERRED_PROVIDER_virtual/bootloader       ?= "u-boot-adi"
PREFERRED_PROVIDER_optee-os                 ?= "optee-os-adi"
PREFERRED_PROVIDER_optee-os-tadevkit        ?= "optee-os-tadevkit-adi"
PREFERRED_PROVIDER_optee-apps               ?= "optee-apps-adi"
PREFERRED_PROVIDER_optee-apps-userspace     ?= "optee-apps-userspace-adi"
PREFERRED_PROVIDER_optee-keys-native        ?= "optee-keys-adi-native"
PREFERRED_PROVIDER_boot-wrapper-aarch64     ?= "boot-wrapper-aarch64-adi"
```

## conf/machine/include/adi_socfpga_default_providers.inc
```bitbake
PREFERRED_PROVIDER_virtual/kernel  ?= "linux-socfpga-lts"
PREFERRED_PROVIDER_virtual/bootloader ?= "u-boot-socfpga"
PREFERRED_PROVIDER_adi-fpga-image ?= "adi-fpga-image-donut"
PREFERRED_PROVIDER_adi-rsu-client ?= "adi-rsu-client-donut"
```

## conf/machine/include/adi_socfpga_default_settings.inc
```bitbake
require adi_socfpga_default_providers.inc
require adi_socfpga_default_versions.inc
require conf/machine/include/socfpga_armv8a.inc
```

## conf/machine/include/adi_socfpga_default_versions.inc
```bitbake
PREFERRED_VERSION_linux-socfpga-lts ?= "5.10%"

PREFERRED_VERSION_u-boot-socfpga ?= "v2021.04%"

UBOOT_LOCALVERSION ?= "-yocto-adi-${MACHINE}-1.0"

PREFERRED_VERSION_arm-trusted-firmware ?= "v2.7"
```

## conf/machine/include/adrv906x_nor_flash_layout.inc
```bitbake
NOR_BOOT_A_START ?= "0"
NOR_BOOT_B_START ?= "262144"
NOR_BOOT_SIZE ?= "262144"
NOR_BOOTCTRL_START ?= "524288"
NOR_BOOTCTRL_SIZE ?= "65536"
NOR_BOOTCFG_START ?= "589824"
NOR_BOOTCFG_SIZE ?= "65536"
NOR_FIP_A_START ?= "655360"
NOR_FIP_B_START ?= "2752512"
NOR_FIP_SIZE ?= "2097152"
NOR_KERNEL_A_START ?= "4849664"
NOR_KERNEL_B_START ?= "55181312"
NOR_KERNEL_SIZE ?= "50331648"
```

## conf/machine/include/qemu_defaults.inc
```bitbake
EXTRA_IMAGEDEPENDS += "qemu-system-native qemu-helper-native:do_addto_recipe_sysroot"
IMAGE_CLASSES += "qemuboot"

# For runqemu
QB_SYSTEM_NAME = "qemu-system-aarch64"
QB_MACHINE = "-machine virt"
QB_CPU = "-cpu cortex-a57"
QB_SMP = "-smp 4"
QB_DEFAULT_FSTYPE = "ext3"
QB_CPU_KVM = "-cpu host -machine gic-version=3"

# Virtio Networking support
QB_TAP_OPT = "-netdev tap,id=net0,ifname=@TAP@,script=no,downscript=no"
QB_NETWORK_DEVICE = "-device virtio-net-pci,netdev=net0,mac=@MAC@"

# Virtio serial console
QB_SERIAL_OPT = "-device virtio-serial-pci -chardev null,id=virtcon -device virtconsole,chardev=virtcon"
QB_TCPSERIAL_OPT = "-device virtio-serial-pci -chardev socket,id=virtcon,port=@PORT@,host=127.0.0.1 -device virtconsole,chardev=virtcon"

QB_KERNEL_CMDLINE_APPEND = "uio_pdrv_genirq.of_id=generic-uio earlyprintk"
```

## intel-fpga/recipes-kernel/linux-socfpga/files/Documentation/devicetree/bindings/ptp/ptp-adi.yaml
```yaml
# SPDX-License-Identifier: (GPL-2.0 OR BSD-2-Clause)
%YAML 1.2
---
$id: http://devicetree.org/schemas/ptp/ptp-adi.yaml#
$schema: http://devicetree.org/meta-schemas/core.yaml#

title: ADI PTP Clock Device Tree Bindings

maintainers:
  - Landau Zhang <landau.zhang@analog.com>

properties:
  compatible:
    const: adi,adi-ptp

  reg:
    maxItems: 1

  clock-names:
    description:
      List of input clock names - "sys_clk"
  clocks:
    description:
      Clock phandles and specifiers (See clock bindings for details on clock-names and clocks).

  adi,clk-i2c:
    description:
      The reference to the i2c connected clock node when use the i2c connecting to the clock chip directly
    
  adi,max-adj:
    description:
      The maximum possible frequency adjustment, in parts per billion 
    minimum: 0
    maximum: 1000000000
  
  adi,trigger-mode:
    description:
      The read and write trigger mode of the ToD counter, 
      "0" refers to the GC trigger moode, "1" refers to the 1PPS trigger mode,
      Default is GC trigger
    minimum: 0
    maximum: 1

  adi,trigger-delay-tick:
    description:
      The trigger tick count for the GC trigger mode based on the clock-frequency, 
      Ignored if the tigger mode is 1PPS
    minimum: 0
    maximum: 0xFFFFFFFFFFFF
  
  adi,ppsx-delay-offset-ns:
    description:
      Value of ppsx pulse start,
      Default is 0
    minimum: 0
    maximum: 999999999

  adi,ppsx-pulse-width-ns:
    description:
      Value of ppsx pulse width
      Default is 500000000
    minimum: 1
    maximum: 999999999

required:
  - compatible
  - reg
  - clock-names
  - clocks
  - adi,clk-type
  - adi,trigger-mode
  - adi,trigger-delay-tick

additionalProperties: false

examples:
  - |
    ptpclk: ptpclk {
      compatible = "adi,adi-ptp";
      reg = <0x2b380000 0xff>;
      clocks = <&sysclk>;
		  clock-names = "sys_clk";
      adi,clk-i2c = <&ad9545>;
      adi,max_adj = <50>;
      adi,trigger-mode = <0>;
      adi,trigger-delay-tick = <491520>;
      adi,ppsx-delay-offset-ns = <0>;
      adi,ppsx-pulse-width-ns = <500000000>;
      status = "disabled";
    };
```
